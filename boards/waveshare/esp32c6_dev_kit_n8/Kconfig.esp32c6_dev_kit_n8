## boards/waveshare/esp32c6_dev_kit_n8/Kconfig.esp32c6_dev_kit_n8
```kconfig
# Waveshare ESP32-C6-DEV-KIT-N8 board configuration

# Copyright (c) 2024 Espressif Systems (Shanghai) Co., Ltd.
# SPDX-License-Identifier: Apache-2.0

config BOARD_ESP32C6_DEV_KIT_N8
	select SOC_ESP32_C6_WROOM_1U_N8
	select SOC_ESP32C6_HPCORE if BOARD_ESP32C6_DEV_KIT_N8_ESP32C6_HPCORE
	select SOC_ESP32C6_LPCORE if BOARD_ESP32C6_DEV_KIT_N8_ESP32C6_LPCORE
```

## boards/waveshare/esp32c6_dev_kit_n8/board.yml
```yaml
board:
  name: esp32c6_dev_kit_n8
  full_name: ESP32-C6-DEV-KIT-N8
  vendor: waveshare
  socs:
  - name: esp32c6
```

## tests/ais_mmsi_filter/testcase.yaml
```yaml
tests:
  esp_nmea_bridge.ais_mmsi_filter:
    platform_allow: native_sim
    tags: ais nmea
```

## tests/bridge_config/testcase.yaml
```yaml
tests:
  esp_nmea_bridge.bridge_config:
    platform_allow: native_sim
    tags: bridge_config settings
```

## tests/ota_update/testcase.yaml
```yaml
tests:
  esp_nmea_bridge.ota_update:
    platform_allow: native_sim
    tags: ota dfu mcuboot
```

## tests/status_led/Kconfig
```kconfig
# Test-only knobs for the status LED hardware failure suite

# Mirrors the app symbol from the root Kconfig (without `select LED_STRIP`,
# the fake driver replaces the real strip) so status_led.h compiles the
# hardware path.
config ESP_NMEA_BRIDGE_STATUS_LED_ENABLE
	bool
	default y

config TEST_FAKE_LED_STRIP
	bool "Compile the fake LED strip driver"

config TEST_FAKE_LED_STRIP_INIT_FAIL
	bool "Make the fake LED strip fail device init"
	depends on TEST_FAKE_LED_STRIP

config TEST_STATUS_LED_SCENARIO_NO_DEVICE
	bool "Scenario: no led-strip devicetree alias"

config TEST_STATUS_LED_SCENARIO_NOT_READY
	bool "Scenario: led-strip device not ready"

config TEST_STATUS_LED_SCENARIO_UPDATE_FAILURE
	bool "Scenario: led-strip update failures with retry backoff"

source "Kconfig.zephyr"
```

## tests/status_led/dts/bindings/vnd,fake-led-strip.yaml
```yaml
description: Fake LED strip used to exercise status LED hardware failure paths

compatible: "vnd,fake-led-strip"

include: base.yaml
```

## tests/status_led/testcase.yaml
```yaml
tests:
  esp_nmea_bridge.status_led.no_device:
    platform_allow: native_sim
    tags: status_led
    extra_configs:
      - CONFIG_TEST_STATUS_LED_SCENARIO_NO_DEVICE=y
  esp_nmea_bridge.status_led.not_ready:
    platform_allow: native_sim
    tags: status_led
    extra_args:
      - DTC_OVERLAY_FILE=fake_strip.overlay
    extra_configs:
      - CONFIG_TEST_FAKE_LED_STRIP=y
      - CONFIG_TEST_FAKE_LED_STRIP_INIT_FAIL=y
      - CONFIG_TEST_STATUS_LED_SCENARIO_NOT_READY=y
  esp_nmea_bridge.status_led.update_failure:
    platform_allow: native_sim
    tags: status_led
    extra_args:
      - DTC_OVERLAY_FILE=fake_strip.overlay
    extra_configs:
      - CONFIG_TEST_FAKE_LED_STRIP=y
      - CONFIG_TEST_STATUS_LED_SCENARIO_UPDATE_FAILURE=y
```

## tests/web_app_ota/testcase.yaml
```yaml
tests:
  esp_nmea_bridge.web_app_ota_boundary:
    platform_allow: native_sim
    tags: web_app ota http
```
