/*
 * Copyright (c) 2025 Espressif Systems (Shanghai) Co., Ltd.
 *
 * SPDX-License-Identifier: Apache-2.0
 */
/dts-v1/;

#include <espressif/esp32c6/esp32c6_lpcore_wroom_n4.dtsi>
#include <espressif/partitions_0x0_default.dtsi>

/ {
	model = "Waveshare ESP32-C6-DEV-KIT-N8 LPCORE";
	compatible = "waveshare,esp32-c6-dev-kit-n8";

	chosen {
		zephyr,sram = &ulp_ram;
		zephyr,code-partition = &slot0_lpcore_partition;
		zephyr,console = &lp_uart;
		zephyr,shell-uart = &lp_uart;
	};
};

&lp_uart {
	status = "okay";
	current-speed = <115200>;
};
